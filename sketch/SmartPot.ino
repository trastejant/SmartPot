//Llamadas a las librerias necesarias

#include <ASCII.h>//Libreria de caracteres ASCII
#include <NokiaLCD.h>//Libreria para el display
#include <DHT.h>//Libreria del sensor de temperatura y humedad

//Configuracion del sensor de humedad y temperatura

#define DHTPIN 12//Declaramos que el sensor esta en el pin 12
#define DHTTYPE DHT11//Definimos el modelo del sensor    
DHT dht(DHTPIN, DHTTYPE);//Definimos un objeto que utilizaremos para comunicarnos con el sensor    

//Configuracion del display
NokiaLCD NokiaLCD(3,4,5,6,7); // (SCK, MOSI, DC, RST, CS) 

//Definicion de constantes
#define umbralLuminosidad 200
#define umbralOscuridad 20
#define umbralCalor 35
#define umbralFrio 10
#define umbralHumedad 150

//Definicion de variables    
boolean tMenu = true;
float Acthum, ActTemp, AntTemp, AntHum;
int backlight = 8;
int luminosidad = 0;
int HumTierra = 0;
//Variables auxiliares

char humedad[6];
char temperatura[6];

//Caras del modo grafico--------------------------------------->

//imagen de carita sonriente
static unsigned char smille[] = {

0xFF, 0xFF, 0xFF, 0xFF, 0xFF, 0xFF, 0xFF, 0xFF, 0xFF, 0xFF, 0xFF, 
0xFF, 0xFF, 0xFF, 0x7F, 0x7F, 0x3F, 0x3F, 0x3F, 0x1F, 0x1F, 0x0F, 
0x0F, 0x0F, 0x07, 0x07, 0x07, 0x07, 0x07, 0x03, 0x03, 0x03, 0x03, 
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0xFF, 0xFF, 0xFF, 0xFF, 0xFF, 0xFF, 0xFF, 0xFF, 0xFF

};

//icono de carita triste
static unsigned char triste[] = {
0x00, 0x00, 0x00, 0x00, 0x00, 0x00, 0x00, 0x00, 0x00, 0x00, 0x00, 
0x00, 0x00, 0x00, 0x00, 0x00, 0x00, 0x00, 0x00, 0x00, 0x00, 0x00, 
0x00, 0x00, 0x00, 0x00, 0x00, 0x00, 0x00, 0x00, 0x00, 0x00, 0x00, 
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0x00, 0x00, 0x00, 0x00, 0x00, 0x00, 0x00, 0x00, 0x00 
};

//icono exceso de luz
static unsigned char sol[] = {
0x00, 0x00, 0x00, 0x00, 0x00, 0x00, 0x00, 0x00, 0x00, 0x00, 0x00, 
0x00, 0x00, 0x00, 0x00, 0x00, 0x00, 0x00, 0x00, 0x00, 0x00, 0x00, 
0x00, 0x00, 0x00, 0x00, 0x00, 0x00, 0x00, 0x00, 0x00, 0x00, 0x00, 
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0x00, 0x00, 0x00, 0x00, 0x00, 0x00, 0x00, 0x00, 0x00
};

//icono calor
static unsigned char calor[]= {
0x00, 0x00, 0x00, 0x00, 0x00, 0x00, 0x00, 0x00, 0x00, 0x00, 0x00, 
0x00, 0x00, 0x00, 0x00, 0x00, 0x00, 0x00, 0x00, 0x00, 0x00, 0x00, 
0x00, 0x00, 0x00, 0x00, 0x00, 0x00, 0x80, 0x80, 0x80, 0x00, 0x00, 
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0x00, 0x00, 0x00, 0x00, 0x00, 0x00, 0x00, 0x00, 0x00 
};

//icono frio
static unsigned char frio[]= {
0x00, 0x00, 0x00, 0x00, 0x00, 0x00, 0x00, 0x00, 0x00, 0x00, 0x00, 
0x00, 0x00, 0x00, 0x00, 0x00, 0x00, 0x80, 0x80, 0xC0, 0xC0, 0xE0, 
0xF0, 0xF0, 0xF8, 0xF8, 0x78, 0x70, 0xF4, 0x3C, 0x7C, 0x78, 0x7A, 
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0x00, 0x00, 0x00, 0x00, 0x00, 0x00, 0x00, 0x00, 0x00
};


//Sin luz
static unsigned char oscuridad[]= {
0x00, 0x00, 0x00, 0x00, 0x00, 0x00, 0x00, 0x00, 0x00, 0x00, 0x00, 
0x00, 0x00, 0x00, 0x00, 0x00, 0x00, 0x00, 0x00, 0x0C, 0x0C, 0x14, 
0x14, 0x14, 0x10, 0x10, 0x10, 0x90, 0x90, 0x10, 0x50, 0x72, 0x30, 
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0x00, 0x00, 0x00, 0x00, 0x00, 0x00, 0x00, 0x00, 0x00 

};



void setup(){
  
 
  Serial.begin(9600);//Iniciamos la comunicación serial                
  dht.begin(); //Iniciamos el sensor de humedad y temperatura    
  NokiaLCD.init();   //Iniciar pantalla
  
  NokiaLCD.clear();  //Limpiar pantalla
  
  //iniciarlizar variables 
  AntTemp = 0;//Variable de la ultma temperatura medida
  AntHum = 0;//Variable de la ultima humedad de aire medida
  
  //configuracion de pines
  pinMode(backlight,OUTPUT);//Pin conectado a la iluminacion de la pantalla
  attachInterrupt(0, colision, CHANGE);//iniciamos la interrupcion para el boton      
  pinMode(2, INPUT);//COnfiguramos el pin 2 (el del boton) como salida
  digitalWrite(2, HIGH);//Activamos la resistencia Pull-Up en el pin 2 (el del boton)
}

void loop(){
      
  //Mostramos la información en la consola      
  Serial.print("Humedad: ");     
  Serial.println(dht.readHumidity());    
  Serial.print("Temperatura: ");    
  Serial.println(dht.readTemperature());    
  
  //Leemos la informacion de los sensores
  Acthum = dht.readHumidity();//leemos humedad
  ActTemp = dht.readTemperature();//leemos temperatura    
  
  dtostrf(dht.readTemperature(), 5, 2, temperatura); //cast de la temperatura
  dtostrf(dht.readHumidity(), 5, 2, humedad);//cast de la humedad
  if(tMenu == true){
    
    //Menu Grafico
    NokiaLCD.clear();//Limpiamos la pantalla
    Serial.println("MENU GRAFICO");
    /*NokiaLCD.print("Modo Grafico");*/    
    NokiaLCD.bitmap(sol);
    if(luminosidad < umbralOscuridad){NokiaLCD.bitmap(oscuridad);}//Si la habitacion esta oscura mostramos la cara que duerme
    else if(luminosidad < umbralLuminosidad){NokiaLCD.bitmap(sol);}//Si hay demasiada luminosidad mostramos la cara con gafas de sol
    else if(ActTemp < umbralFrio){NokiaLCD.bitmap(frio);}//Si la temperatura es inferior a lo que tenemos configurado, mostramos frio
    else if(ActTemp > umbralCalor){NokiaLCD.bitmap(calor);}//Si la temperatura es superior a lo que tenemos configurado, mostramos calor
    else if(HumTierra < umbralHumedad){NokiaLCD.bitmap(triste);}//Si la planta necesita riego, mostramos la cara triste
    else{NokiaLCD.bitmap(smille);}
  }else{
    //menu de texto con las lecturas tomadas. 
    NokiaLCD.clear();//Limpiamos la pantalla
    Serial.println("Texto");
    NokiaLCD.setCursor(1,1);  
    NokiaLCD.print(temperatura);  
    
    NokiaLCD.setCursor(1,2);  
    NokiaLCD.print(humedad);  
    
    NokiaLCD.setCursor(1,3);  
    NokiaLCD.print("Suelo: ");  
  
    NokiaLCD.setCursor(1,5);  
    NokiaLCD.print("Trastejant"); 
  }
  
  //Encendemos la pantalla si hay alguna alteracion
  Acthum = dht.readHumidity();//leemos humedad
  ActTemp = dht.readTemperature();//leemos temperatura
  
  if(AntTemp != ActTemp){
    digitalWrite(backlight,HIGH);//encendemos la iluminacion del display
    AntTemp = ActTemp;//guardamos la nueva temperatura
  }
  
  if(AntHum != Acthum){
    digitalWrite(backlight,HIGH);//encendemos la iluminacion del display
    AntHum = Acthum;//guardamos la nueva humedad
  }
  
  delay(3000);//tiempo con el display iluminado   
  digitalWrite(backlight,LOW);//apagamos la iluminacion del display
}

 void colision(){tMenu = !tMenu;}  //Funcion llamada en caso de interrupcion
 void mensaje(){Serial.println("Boton pulsado");}
